## drivers/infiniband/hw/sxe2rdma/Kconfig
```kconfig
# SPDX-License-Identifier: GPL-2.0
#
# SXE2 RDMA device configuration
#

config INFINIBAND_SXE2RDMA
	tristate "sxe2 network adapters RDMA support"
	depends on X86 || ARM64
	depends on NETDEVICES && ETHERNET && PCI
	depends on INET && IPV6
	depends on SXE2
	depends on INFINIBAND && INFINIBAND_USER_ACCESS
	select AUXILIARY_BUS
	select CONFIGFS_FS
	default n
	help
	  This driver supports RDMA on sxe2 PCI Express network adapters.
	  It requires the SXE2 Ethernet driver and RDMA userspace access.

	  To compile this driver as a module, choose M here. The module
	  will be called sxe2rdma.
```

## drivers/iommu/hisilicon/dtu/Kconfig
```kconfig
# SPDX-License-Identifier: GPL-2.0+
#
# Hisilicon UB DTU support
#

config UB_DTU
	bool "Support UB DTU (Device Translation Unit)"
	depends on UB_UMMU
	help
	  Support the UB DTU, a per-die device attached to the UMMU that
	  translates device addresses through address windows instead of
	  page tables.
	  When enabled, the UMMU driver registers a DTU iommu instance that
	  configures per-die address windows.
	  Say Y here if your SoC integrates a UB DTU. If unsure, say N.
```

## drivers/ub/cdma/Kconfig
```kconfig
# SPDX-License-Identifier: GPL-2.0+
menuconfig UB_CDMA
	default n
	tristate "cdma driver"
	depends on UB_UBASE && UB_UMMU_CORE_DRIVER
	help
	   This option enables support for CDMA drivers. The CDMA driver facilitates
	   the creation and destruction of CDMA devices, as well as the creation of
	   resources within CDMA devices to perform DMA read/write tasks and retrieve
	   the completion status of executed tasks.
```

## drivers/ub/ubmempfd/Kconfig
```kconfig
# SPDX-License-Identifier: GPL-2.0+
# UB Memory virtualization support
config UB_UBMEMPFD
	tristate "ubmempfd driver"
	depends on UB_UMMU_CORE_DRIVER
	select IOMMU_API
	help
	   This option enables support for ubmempfd drivers. The ubmempfd
	   driver provides address mapping on the host side for QEMU,
	   which is a virtualization software that supports UB. And
	   the vUMMU Driver implements the virtualization function of
	   UMMU devices.
```
