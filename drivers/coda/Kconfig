## drivers/coda/Kconfig
```kconfig
config HISI_VIRTCCA_CODA
	bool "Support for virtCCA Confidential Device Assignment"
	default y
	depends on HISI_VIRTCCA_HOST
	help
	  Support VIRTCCA Device Assignment based on S-EL2

	  If unsure, say Y.
```

## drivers/crypto/hisilicon/Kconfig
```kconfig
# SPDX-License-Identifier: GPL-2.0

config CRYPTO_DEV_HISI_SEC
	tristate "Support for Hisilicon SEC crypto block cipher accelerator"
	select CRYPTO_BLKCIPHER
	select CRYPTO_ALGAPI
	select SG_SPLIT
	depends on ARM64 || COMPILE_TEST
	depends on HAS_IOMEM
	help
	  Support for Hisilicon SEC Engine in Hip06 and Hip07

	  To compile this as a module, choose M here: the module
	  will be called hisi_sec.

config CRYPTO_DEV_HISI_QM
	tristate
	depends on ARM64 && PCI

config CRYPTO_QM_UACCE
	bool "enable UACCE support for all acceleartor with Hisi QM"
	depends on CRYPTO_DEV_HISI_QM
	select UACCE
	help
	  Support UACCE interface in Hisi QM.

config CRYPTO_DEV_HISI_ZIP
	tristate "Support for HISI ZIP Driver"
	depends on ARM64 && ACPI
	select CRYPTO_DEV_HISI_QM
	help
	  Support for HiSilicon HIP08 ZIP Driver.

config CRYPTO_DEV_HISI_HPRE
	tristate "Support for HISI HPRE accelerator"
	depends on PCI && PCI_MSI && ACPI
	depends on ARM64
	select CRYPTO_DEV_HISI_QM
	select CRYPTO_DH
	select CRYPTO_RSA
	help
	  Support for HiSilicon HPRE(High Performance RSA Engine)
	  accelerator, which can accelerate RSA and DH algorithms.

config CRYPTO_DEV_HISI_SEC2
	tristate "Support for HISI SEC Driver"
	depends on ARM64 && ACPI
	select CRYPTO_DEV_HISI_QM
	select CRYPTO_BLKCIPHER
	select CRYPTO_ALGAPI
	help
	  Support for HiSilicon HIP09 SEC Driver.

config CRYPTO_DEV_HISI_RDE
	tristate "Support for HISI RDE Driver"
	depends on ARM64 && ACPI
	select CRYPTO_DEV_HISI_QM
	help
	  Support for HiSilicon HIP09 RDE Driver.
```

## drivers/fwctl/Kconfig
```kconfig
# SPDX-License-Identifier: GPL-2.0-only
menuconfig FWCTL
	tristate "fwctl device firmware access framework"
	help
	  fwctl provides a userspace API for restricted access to communicate
	  with on-device firmware. The communication channel is intended to
	  support a wide range of lockdown compatible device behaviors including
	  manipulating device FLASH, debugging, and other activities that don't
	  fit neatly into an existing subsystem.

if FWCTL
config FWCTL_UB
	tristate "ub_fwctl depend on fwctl driver"
	depends on UB_UBASE
	default n
	help
	  ub_fwctl provides users with various information related to
	  querying UB (UnifiedBus) registers or devices.

	  If you don't know what to do here, say N.
endif
```

## drivers/gpu/drm/inspur/Kconfig
```kconfig
config DRM_INSPUR
	tristate "DRM Support for Inspur BMC"
	depends on DRM && PCI && MMU
	select DRM_KMS_HELPER
	select DRM_VRAM_HELPER

	help
	  Choose this option if you have a Inspur soc chipset.
	  If M is selected the module will be called inspur-drm.
	  IF you use gnome3, please set "WaylandEnable=false" in
	  "vim /etc/gdm3/custom.conf" and reboot.
```

## drivers/gpu/drm/loongson/Kconfig
```kconfig
# SPDX-License-Identifier: GPL-2.0

config DRM_LOONGSON
	tristate "DRM Support for loongson's display controller"
	depends on DRM && PCI
	depends on MACH_LOONGSON64 || LOONGARCH || MIPS || COMPILE_TEST
	select OF
	select CMA if HAVE_DMA_CONTIGUOUS
	select DMA_CMA if HAVE_DMA_CONTIGUOUS
	select DRM_KMS_HELPER
	select DRM_KMS_FB_HELPER
	select DRM_KMS_CMA_HELPER
	select DRM_GEM_CMA_HELPER
	select DRM_TTM
	select DRM_TTM_HELPER
	select DRM_VRAM_HELPER
	select VIDEOMODE_HELPERS
	select DRM_BRIDGE
	select DRM_PANEL_BRIDGE
	default y
	help
	  This is a KMS driver for the display controller in the LS7A1000
	  bridge chip and LS2K1000/LS2K0500 SoC.
	  If "M" is selected, the module will be called loongson.

	  If in doubt, say "Y".
```

## drivers/gpu/drm/phytium/Kconfig
```kconfig
# SPDX-License-Identifier: GPL-2.0-only

config DRM_PHYTIUM
	tristate "DRM Support for Phytium Graphics Card"
	depends on DRM && ARCH_PHYTIUM
	select DRM_KMS_HELPER
	select DRM_DISPLAY_HELPER
	select DRM_DISPLAY_DP_HELPER
	select DRM_DISPLAY_HDCP_HELPER
	help
	  Choose this option if you have a phytium graphics card.
	  This driver provides kernel mode setting and buffer management to userspace.
```

## drivers/hooks/Kconfig
```kconfig
# SPDX-License-Identifier: GPL-2.0
menu "Vendor Hooks"

config VENDOR_HOOKS
        bool "Vendor Hooks"
        depends on TRACEPOINTS
        help
          Enable vendor hooks implemented as tracepoints

          Allow vendor modules to attach to tracepoint "hooks" defined via
          DECLARE_HOOK or DECLARE_RESTRICTED_HOOK.

config VENDOR_BOND_HOOKS
        bool "Ethernet Bonding driver Vendor Hooks"
        depends on VENDOR_HOOKS && BONDING
        default n
        help
	  Enable ethernet bonding driver vendor hooks

          Allow vendor modules to attach bonding driver hooks defined via
          DECLARE_HOOK or DECLARE_RESTRICTED_HOOK.

endmenu
```

## drivers/infiniband/hw/hiroce3/Kconfig
```kconfig
# SPDX-License-Identifier: GPL-2.0-only
#
# Huawei driver configuration
#

config HIROCE3
	tristate "Huawei Intelligent Network Interface Card RDMA Driver"
	depends on HINIC3 && PCI_MSI && NUMA && PCI_IOV && DCB && (X86 || ARM64)
	help
	  This driver supports HiROCE PCIE Ethernet cards.
	  To compile this driver as part of the kernel, choose Y here.
	  If unsure, choose N.
	  The default is N.
```

## drivers/infiniband/hw/xsc/Kconfig
```kconfig
# SPDX-License-Identifier: GPL-2.0
# Copyright (C) 2021 - 2023, Shanghai Yunsilicon Technology Co., Ltd.
# All rights reserved.

config INFINIBAND_XSC
	tristate "Yunsilicon XSC RDMA driver"
	default n
	depends on NETDEVICES && ETHERNET && PCI && INET
	depends on YUNSILICON_XSC_PCI && YUNSILICON_XSC_ETH
	help
	  This driver provides RDMA support for
	  Yunsilicon XSC devices.
```

## drivers/iommu/sw64/Kconfig
```kconfig
# SPDX-License-Identifier: GPL-2.0-only
# SW64 IOMMU SUPPORT
config SUNWAY_IOMMU
        bool "Sunway IOMMU Support"
        select IOMMU_API
        select IOMMU_IOVA
        depends on SW64 && PCI
        help
          Support for IOMMU on SW64 platform.
```

## drivers/misc/sdma-dae/Kconfig
```kconfig
config SDMA_DAE
	tristate "SDMA-DAE driver for SDMA hardware"
	depends on ARM64 && NUMA
	default n
	help
	  Kernel driver of SDMA hardware.
	  The driver depands on ARM64.
	  To compile SDMA driver as module, choose m here.
	  module will be called sdma_dae.
```

## drivers/mmc/Kconfig
```kconfig
#
# MMC subsystem configuration
#

menuconfig MMC
	tristate "MMC/SD/SDIO card support"
	depends on HAS_IOMEM
	help
	  This selects MultiMediaCard, Secure Digital and Secure
	  Digital I/O support.

	  If you want MMC/SD/SDIO support, you should say Y here and
	  also to your specific host controller driver.

config ASCEND_HISI_MMC
	bool "Ascend HiSilicon MMC card support"
	depends on MMC
	default n
	help
	  This selects for Hisilicon SoC specific extensions to the
	  Synopsys DesignWare Memory Card Interface driver.
	  You should select this option if you want mmc support on
	  Ascend platform.

if MMC

source "drivers/mmc/core/Kconfig"

source "drivers/mmc/host/Kconfig"

endif # MMC
```

## drivers/net/ethernet/huawei/bma/Kconfig
```kconfig
#
# Huawei BMA software driver configuration
#

config BMA
	tristate "Huawei BMA Driver"
	depends on 64BIT
	help
		This driver supports Huawei BMA Software. It is used
		to communication between Huawei BMA and BMC software.
```

## drivers/net/ethernet/linkdata/sxe/Kconfig
```kconfig
# SPDX-License-Identifier: GPL-2.0
#
# sxe network device configuration
#

config SXE
	tristate "sxe PCI Express adapters support"
	depends on (X86 || ARM64) && PCI
	select MDIO
        select PHYLIB
        select PTP_1588_CLOCK
        default m
	help
	  This driver supports sxe PCI Express family of adapters.

	  To compile this driver as a module, choose M here. The module
	  will be called ngbe.
```

## drivers/net/ethernet/linkdata/sxe2/Kconfig
```kconfig
# SPDX-License-Identifier: GPL-2.0
#
# sxe2 network device configuration
#

config SXE2
	tristate "sxe2 PCI Express adapters support"
	depends on (X86) && PCI
	select MDIO
        select PHYLIB
        select PTP_1588_CLOCK
        default m
	help
	  This driver supports sxe2 PCI Express family of adapters.

	  To compile this driver as a module, choose M here. The module
	  will be called sxe2.
```

## drivers/net/ethernet/linkdata/sxe2vf/Kconfig
```kconfig
# SPDX-License-Identifier: GPL-2.0
#
# sxe2vf network device configuration
#

config SXE2_VF
	tristate "sxe2vf PCI Express adapters support"
	depends on (X86) && PCI
	select MDIO
        select PHYLIB
        select PTP_1588_CLOCK
        default m
	help
	  This driver supports sxe2vf PCI Express family of adapters.

	  To compile this driver as a module, choose M here. The module
	  will be called sxe2vf.
```

## drivers/net/ethernet/linkdata/sxevf/Kconfig
```kconfig
# SPDX-License-Identifier: GPL-2.0
#
# sxevf network device configuration
#

config SXE_VF
	tristate "sxevf PCI Express adapters support"
	depends on (X86 || ARM64) && PCI
	select MDIO
        select PHYLIB
        select PTP_1588_CLOCK
        default m
	help
	  This driver supports sxevf PCI Express family of adapters.

	  To compile this driver as a module, choose M here. The module
	  will be called ngbe.
```

## drivers/net/ethernet/netswift/Kconfig
```kconfig
# SPDX-License-Identifier: GPL-2.0-only
#
# Netswift network device configuration
#

config NET_VENDOR_NETSWIFT
	bool "netswift devices"
	default y
	help
	  If you have a network (Ethernet) card belonging to this class, say Y.

	  Note that the answer to this question doesn't directly affect the
	  kernel: saying N will just cause the configurator to skip all
	  the questions about Netswift NICs. If you say Y, you will be asked for
	  your specific card in the following questions.

if NET_VENDOR_NETSWIFT

config NGBE
	tristate "Netswift PCI-Express Gigabit Ethernet support"
	depends on PCI
	imply PTP_1588_CLOCK
	help
	  This driver supports Netswift gigabit ethernet adapters.
	  For more information on how to identify your adapter, go
	  to <http://www.net-swift.com>

	  To compile this driver as a module, choose M here. The module
	  will be called ngbe.

config NGBE_HWMON
	bool "Netswift PCI-Express Gigabit adapters HWMON support"
	default n
	depends on NGBE && HWMON && !(NGBE=y && HWMON=m)
	help
	  Say Y if you want to expose thermal sensor data on these devices.
	  For more information on how to identify your adapter, go
          to <http://www.net-swift.com>

	  If unsure, say N.

config NGBE_DEBUG_FS
	bool "Netswift PCI-Express Gigabit adapters debugfs support"
	default n
	depends on NGBE
	help
	  Say Y if you want to setup debugfs for these devices.
	  For more information on how to identify your adapter, go
          to <http://www.net-swift.com>

	  If unsure, say N.

config NGBE_POLL_LINK_STATUS
	bool "Netswift PCI-Express Gigabit adapters poll mode support"
	default n
	depends on NGBE
	help
	  Say Y if you want to turn these devices to poll mode instead of interrupt-trigged TX/RX.
	  For more information on how to identify your adapter, go
          to <http://www.net-swift.com>

	  If unsure, say N.

config NGBE_SYSFS
	bool "Netswift PCI-Express Gigabit adapters sysfs support"
	default n
	depends on NGBE
	help
	  Say Y if you want to setup sysfs for these devices.
	  For more information on how to identify your adapter, go
          to <http://www.net-swift.com>

	  If unsure, say N.

config TXGBE
        tristate "Netswift PCI-Express 10Gigabit Ethernet support"
        depends on PCI
        imply PTP_1588_CLOCK
        help
          This driver supports Netswift 10gigabit ethernet adapters.
 	  For more information on how to identify your adapter, go
          to <http://www.net-swift.com>

          To compile this driver as a module, choose M here. The module
	  will be called txgbe.

config TXGBE_HWMON
	bool "Netswift PCI-Express 10Gigabit adapters HWMON support"
	default n
	depends on TXGBE && HWMON && !(TXGBE=y && HWMON=m)
	help
	  Say Y if you want to expose thermal sensor data on these devices.
	  For more information on how to use your adapter, go
	  to <http://www.net-swift.com>

	  If unsure, say N.

config TXGBE_DEBUG_FS
	bool "Netswift PCI-Express 10Gigabit adapters debugfs support"
	default n
	depends on TXGBE
	help
	  Say Y if you want to setup debugfs for these devices.
	  For more information on how to use your adapter, go
	  to <http://www.net-swift.com>

	  If unsure, say N.

config TXGBE_POLL_LINK_STATUS
	bool "Netswift PCI-Express 10Gigabit adapters poll mode support"
	default n
	depends on TXGBE
	help
	  Say Y if you want to turn these devices to poll mode instead of interrupt-trigged TX/RX.
	  For more information on how to use your adapter, go
	  to <http://www.net-swift.com>

	  If unsure, say N.
config TXGBE_SYSFS
	bool "Netswift PCI-Express 10Gigabit adapters sysfs support"
	default n
	depends on TXGBE
	help
	  Say Y if you want to setup sysfs for these devices.
	  For more information on how to use your adapter, go
	  to <http://www.net-swift.com>

	  If unsure, say N.
endif # NET_VENDOR_NETSWIFT
```

## drivers/net/ethernet/netswift/txgbe/Kconfig
```kconfig
#
# Netswift driver configuration
#

config TXGBE
	tristate "Netswift 10G Network Interface Card"
	default n
	depends on PCI_MSI && NUMA && PCI_IOV && DCB
	help
	  This driver supports Netswift 10G Ethernet cards.
	  To compile this driver as part of the kernel, choose Y here.
	  If unsure, choose N.
	  The default is N.
```

## drivers/net/ethernet/northlink/Kconfig
```kconfig
# SPDX-License-Identifier: GPL-2.0-only
#
# NorthLink device configuration
#

config NET_VENDOR_NORTHLINK
	bool "NorthLink devices"
	default y
	help
	  If you have a network (Ethernet) card belonging to this class, say Y.

	  Note that the answer to this question doesn't directly affect the
	  kernel: saying N will just cause the configurator to skip all
	  the questions about NorthLink devices. If you say Y, you will be asked
	  for your specific device in the following questions.

if NET_VENDOR_NORTHLINK

source "drivers/net/ethernet/northlink/nce/Kconfig"

endif # NET_VENDOR_NORTHLINK
```

## drivers/net/ethernet/northlink/nce/Kconfig
```kconfig
# SPDX-License-Identifier: GPL-2.0-only
#
# NorthLink device configuration


config NCE
	tristate "NorthLink Ethernet Connection N5/N6 Series Support"
	depends on PCI
	help
	  This selects the drivers support NorthLink Ethernet Connection N5/N6 Series devices.

if NCE

config NE6X
	tristate "NorthLink Ethernet Connection N5/N6 Series Support"
	default n
	depends on PCI_MSI
	help
	  This driver supports NorthLink Ethernet Connection N5/N6 Series
	  of devices.

	  To compile this driver as a module, choose M here.
	  The module will be called ncepf.

config NE6XVF
	tristate "NorthLink Ethernet Connection N5/N6 Series Virtual Function support"
	depends on PCI_MSI
	depends on NE6X
	help
	  This driver supports virtual functions for NorthLink Ethernet Connection N5/N6 Series
	  Virtual Function devices.

	  To compile this driver as a module, choose M here. The module
	  will be called ncevf.

endif #NCE
```

## drivers/net/ethernet/ramaxel/Kconfig
```kconfig
# SPDX-License-Identifier: GPL-2.0-only
#
# Ramaxel driver configuration
#

config NET_VENDOR_RAMAXEL
	bool "Ramaxel devices"
	default y
	help
	If you have a network (Ethernet) card belonging to this class, say Y.
	Note that the answer to this question doesn't directly affect the
	kernel: saying N will just cause the configurator to skip all
	the questions about Ramaxel cards. If you say Y, you will be asked
	for your specific card in the following questions.

if NET_VENDOR_RAMAXEL

	source "drivers/net/ethernet/ramaxel/spnic/Kconfig"

endif # NET_VENDOR_RAMAXEL
```
