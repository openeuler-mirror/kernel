## drivers/net/ethernet/ramaxel/spnic/Kconfig
```kconfig
# SPDX-License-Identifier: GPL-2.0-only
#
# Ramaxel SPNIC driver configuration
#

config SPNIC
	tristate "Ramaxel PCIE Network Interface Card"
	default n
	depends on PCI_MSI && NUMA && PCI_IOV && (X86 || ARM64)
	help
	This driver supports Ramaxel PCIE Ethernet cards.
	To compile this driver as part of the kernel, choose Y here.
	 If unsure, choose N.
	The default is N.
```
