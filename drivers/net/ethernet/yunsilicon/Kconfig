## drivers/net/ethernet/yunsilicon/Kconfig
```kconfig
# SPDX-License-Identifier: GPL-2.0
# Copyright (C) 2021 - 2023, Shanghai Yunsilicon Technology Co., Ltd.
# All rights reserved.
# Yunsilicon driver configuration
#

config NET_VENDOR_YUNSILICON
	bool "Yunsilicon devices"
	default y
	depends on PCI || NET
	depends on ARM64 || X86_64
	help
	  If you have a network (Ethernet or RDMA) device belonging to this
	  class, say Y.

	  Note that the answer to this question doesn't directly affect the
	  kernel: saying N will just cause the configurator to skip all
	  the questions about Yunsilicon devices. If you say Y, you will be
	  asked for your specific card in the following questions.

if NET_VENDOR_YUNSILICON

source "drivers/net/ethernet/yunsilicon/xsc/net/Kconfig"
source "drivers/net/ethernet/yunsilicon/xsc/pci/Kconfig"

endif # NET_VENDOR_YUNSILICON
```

## drivers/net/ethernet/yunsilicon/xsc/net/Kconfig
```kconfig
# SPDX-License-Identifier: GPL-2.0
# Copyright (C) 2021 - 2023, Shanghai Yunsilicon Technology Co., Ltd.
# All rights reserved.
# Yunsilicon driver configuration
#

config YUNSILICON_XSC_ETH
	tristate "Yunsilicon XSC ethernet driver"
	default n
	depends on YUNSILICON_XSC_PCI
	help
	  This driver provides ethernet support for
	  Yunsilicon XSC devices.
```

## drivers/net/ethernet/yunsilicon/xsc/pci/Kconfig
```kconfig
# SPDX-License-Identifier: GPL-2.0
# Copyright (C) 2021 - 2023, Shanghai Yunsilicon Technology Co., Ltd.
# All rights reserved.
# Yunsilicon PCI configuration
#

config YUNSILICON_XSC_PCI
	tristate "Yunsilicon XSC PCI driver"
	default n
	select NET_DEVLINK
	select PAGE_POOL
	help
	  This driver is common for Yunsilicon XSC
	  ethernet and RDMA drivers.
```

## drivers/net/ethernet/yusur/Kconfig
```kconfig
# SPDX-License-Identifier: GPL-2.0-only
#
# Yusur network device configuration
#

config NET_VENDOR_YUSUR
        bool "Yusur devices"
        default n
        help
          If you have a network (Ethernet) card belonging to this class, say Y.

	  Note that the answer to this question doesn't directly affect the
	  kernel: saying N will just cause the configurator to skip all
	  the questions about Yusur cards. If you say Y, you will be asked for
	  your specific card in the following questions.

if NET_VENDOR_YUSUR

config YUSUR_K2
        tristate "Yusur KPU FLEXFLOW-2100P PCI Express adapters support"
	depends on PCI_MSI
        depends on PCI
	select AUXILIARY_BUS
        help
	  This driver supports Yusur KPU FLEXFLOW-2100P PCI Express
          family of adapters.
          To compile this driver as a module, choose M here. The module
          will be called ysnic_k2.

endif # NET_VENDOR_YUSUR
```

## drivers/net/ub/Kconfig
```kconfig
# SPDX-License-Identifier: GPL-2.0-only
#
# UBL configuration
#

config UBL
	default n
	tristate "UB link support"
	help
	  This enables UB link support. Say 'Y' or 'm' if your
	  device works in UB.

source "drivers/net/ub/dev/network_mgmt/Kconfig"
```

## drivers/net/ub/dev/network_mgmt/Kconfig
```kconfig
# SPDX-License-Identifier: GPL-2.0-only
#
# NETWORK_MGNT configuration
#

config NETWORK_MGNT
	default n
	tristate "UB network management"
	depends on UBL
	help
	  Add network management drivers to provide the overall
	  framework for these network management protocols.
	  This enables UB link support. Say 'Y' or 'm' if your
	  device works in UB.
```

## drivers/pci/controller/hisi-pcie-customer/Kconfig
```kconfig
config HISILICON_PCIE_CAE
	tristate "hisi custom pcie driver for hiarmtool"
	default m
```

## drivers/platform/loongarch/Kconfig
```kconfig
#
# LOONGARCH Platform Specific Drivers
#

menuconfig LOONGARCH_PLATFORM_DEVICES
	bool "LOONGARCH Platform Specific Device Drivers"
	default y
	help
	  Say Y here to get to see options for device drivers of various
	  LOONGARCH platforms, including vendor-specific netbook/laptop/desktop
	  extension and hardware monitor drivers. This option itself does
	  not add any kernel code.

	  If you say N, all options in this submenu will be skipped and disabled.

if LOONGARCH_PLATFORM_DEVICES

config LOONGSON_GENERIC_LAPTOP
	tristate "Generic Loongson-3 Laptop Driver"
	depends on ACPI
	depends on BACKLIGHT_CLASS_DEVICE
	depends on INPUT
	depends on MACH_LOONGSON64
	select ACPI_VIDEO
	select INPUT_SPARSEKMAP
	default y
	help
	  ACPI-based Loongson-3 family laptops generic driver.

endif # LOONGARCH_PLATFORM_DEVICES
```

## drivers/ras/hisilicon/Kconfig
```kconfig
# SPDX-License-Identifier: GPL-2.0
config PAGE_EJECT
	tristate "page eject"
	default m
	depends on ARM64 && ARCH_HISI && MEMORY_FAILURE
	help
	  Used to eject page, which is achieved by soft_offline_page and
	  unpoison_memory. A linked list is maintained to log the pfns
	  which are offlined by this module. Only the pfns present in the
	  list is allowed to go online.
```

## drivers/remote_pager/Kconfig
```kconfig
# SPDX-License-Identifier: GPL-2.0

menu "remote pager device"

config REMOTE_PAGER
	tristate "remote pager"
	default m
	depends on GMEM
	help
		If unsure, say Y.

config REMOTE_PAGER_MASTER
	tristate "remote pager master"
	default m
	depends on REMOTE_PAGER
	help
		If unsure, say Y.

config REMOTE_PAGER_SLAVE
	tristate "remote pager slave"
	default n
	depends on ARM64
	depends on REMOTE_PAGER
	help
		If you want to remote_pager driver to support the peer function,
		say m.
		If unsure, say N.
endmenu
```

## drivers/roh/Kconfig
```kconfig
# SPDX-License-Identifier: GPL-2.0+

menuconfig ROH
	tristate "ROH support"
	depends on HAS_IOMEM && HAS_DMA
	depends on NET
	depends on INET
	depends on ARM64
	depends on NET_VENDOR_HISILICON
	depends on m
	select IRQ_POLL
	select DIMLIB
	help
	  Core support for ROH. Make sure to also select
	  any protocols you wish to use as well as drivers
	  for your ROH hardware.

	  To compile ROH core as module, choose M here.

if ROH

source "drivers/roh/hw/hns3/Kconfig"

endif # ROH
```

## drivers/roh/hw/hns3/Kconfig
```kconfig
# SPDX-License-Identifier: GPL-2.0+
config ROH_HNS
	tristate "HNS ROH Driver"
	depends on NET_VENDOR_HISILICON
	depends on ARM64
	depends on PCI && HNS3
	help
	  This is a ROH driver for the Hisilicon ROH engine. The engine
	  is used in Hisilicon Hip09 and more further ICT SoC based on
	  PCI device.

	  To compile HIP09 driver as module, choose M here.
```

## drivers/scsi/linkdata/ps3stor/Kconfig
```kconfig
config SCSI_PS3STOR
        tristate "Linkdata ps3stor Storage Controller Device Driver"
        depends on PCI && SCSI
        select SCSI_SAS_ATTRS
        select RAID_ATTRS
        select IRQ_POLL
        help
        This driver supports Linkdata HBA & RAID controllers.
```

## drivers/scsi/spfc/Kconfig
```kconfig
# SPDX-License-Identifier: GPL-2.0-only
#
# Ramaxel SPFC driver configuration
#

config SPFC
	tristate "Ramaxel Fabric Channel Host Adapter Support"
	default m
	depends on PCI && SCSI
	depends on SCSI_FC_ATTRS
	depends on ARM64 || X86_64
	help
	This driver supports Ramaxel Fabric Channel PCIe host adapter.
	To compile this driver as part of the kernel, choose Y here.
	 If unsure, choose N.
	The default is M.
```

## drivers/scsi/spraid/Kconfig
```kconfig
#
# Ramaxel driver configuration
#

config RAMAXEL_SPRAID
	tristate "Ramaxel spraid Adapter"
	depends on PCI && SCSI
	select BLK_DEV_BSGLIB
	depends on ARM64 || X86_64
	help
	This driver supports Ramaxel SPRxxx serial
	raid controller, which has PCIE Gen4 interface
	with host and supports SAS/SATA Hdd/ssd.
```

## drivers/staging/gmjstcm/Kconfig
```kconfig
menu "GMJS TCM support"

config GMJS_TCM
	bool

config GMJS_TCM_CORE
	tristate "GMJS TCM core support"
	depends on ARM64 || MIPS
	default m
	select GMJS_TCM
	help
		GMJS TCM core support.

config GMJS_TCM_SPI
	tristate "GMJS TCM support on SPI interface"
	depends on GMJS_TCM_CORE && SPI_MASTER
	default m
	help
		GMJS TCM support on SPI interface.

endmenu
```

## drivers/uacce/Kconfig
```kconfig
menuconfig UACCE
	tristate "Accelerator Framework for User Land"
	depends on IOMMU_API
	select ANON_INODES
	help
	  UACCE provides interface for the user process to access the hardware
	  without interaction with the kernel space in data path.

	  See Documentation/warpdrive/warpdrive.rst for more details.

	  If you don't know what to do here, say N.

config WD_DUMMY_DEV
	tristate "Support for WrapDrive Dummy Device"
	depends on UACCE
	help
	  Support for WarpDrive test driver with devices (NOT for upstream).

	  If you don't know what to do here, say N.

config WD_DUMMY_V1
	tristate "Support for WrapDrive Dummy Device V1"
	depends on WD_DUMMY_DEV
	help
	  Support for WarpDrive test driver (NOT for upstream).
	  The device is simulated with os

	  If you don't know what to do here, say N.

config WD_DUMMY_V2
	tristate "Support for WrapDrive Dummy Device V2"
	depends on WD_DUMMY_DEV
	help
	  Support for WarpDrive test driver (NOT for upstream).
	  The device is simulated with qemu

	  If you don't know what to do here, say N.
```

## drivers/ub/hw/hns3/Kconfig
```kconfig
# SPDX-License-Identifier: GPL-2.0-only
#
# UDMA_HNS configuration
#

config UB_UDMA_HNS3
	default n
        tristate "HNS3 UB UDMA Driver"
        depends on UB && UB_URMA
        depends on ARM64
        depends on HNS3 && UBL && PCI
        help
          This is a UB_UDMA_HNS3 driver for the Hisilicon UDMA engine.
          This driver depands on ubcore and uburma.
          This driver depands on UBL(UB link). The UDMA_HNS3 is a PCI device.
          To compile UB_UDMA driver as module, choose M here.
          module will be called hns3_udma.
```

## drivers/vfio/spimdev/Kconfig
```kconfig
config VFIO_SPIMDEV
	tristate "Support for Share Parent IOMMU MDEV"
	depends on VFIO_MDEV_DEVICE
	default no
	help
	  Support for VFIO Share Parent IOMMU MDEV, which enable the kernel to
	  support for the light weight hardware accelerator framework, WrapDrive.

          To compile this as a module, choose M here: the module will be called
	  spimdev.
```

## fs/eulerfs/Kconfig
```kconfig
config EULER_FS
	tristate "EulerFS: filesystem for non-volatile memories"
	depends on ARM64 || X86_64
	depends on FS_DAX
	select CRC32
	select LIBCRC32C
	help
		EulerFS is NVDIMM filesystem. It uses soft updates and
		pointer-based dual views to delay synchronous cache flushes
		and reduce latency significantly in critical path.
```

## ipc/Kconfig
```kconfig
config FAST_IPC
    tristate "Fast IPC support"
    default n
    depends on ARM64
    help
       Fast Inter-process call, used to switch threads quickly.
```

## kernel/livepatch/Kconfig
```kconfig
# SPDX-License-Identifier: GPL-2.0-only
config HAVE_LIVEPATCH_FTRACE
	bool
	help
	  Arch supports kernel live patching based on ftrace

config HAVE_LIVEPATCH_WO_FTRACE
	bool
	help
	  Arch supports kernel live patching without ftrace

if HAVE_LIVEPATCH_FTRACE || HAVE_LIVEPATCH_WO_FTRACE
menu "Enable Livepatch"


config LIVEPATCH
	bool "Kernel Live Patching"
	depends on MODULES
	depends on SYSFS
	depends on KALLSYMS_ALL
	depends on HAVE_LIVEPATCH_FTRACE || HAVE_LIVEPATCH_WO_FTRACE
	depends on !TRIM_UNUSED_KSYMS
	depends on DEBUG_INFO
	default n
	help
	  Say Y here if you want to support kernel live patching.
	  This option has no runtime impact until a kernel "patch"
	  module uses the interface provided by this option to register
	  a patch, causing calls to patched functions to be redirected
	  to new function code contained in the patch module.

choice
	prompt "live patching method"
	depends on LIVEPATCH
	help
	  Live patching implementation method configuration.

config LIVEPATCH_FTRACE
	bool "based on ftrace"
	depends on HAVE_LIVEPATCH_FTRACE
	depends on DYNAMIC_FTRACE_WITH_REGS
	select LIVEPATCH_PER_TASK_CONSISTENCY
	help
	  Supports kernel live patching based on ftrace

config LIVEPATCH_WO_FTRACE
	bool "without ftrace"
	depends on HAVE_LIVEPATCH_WO_FTRACE
	select LIVEPATCH_STOP_MACHINE_CONSISTENCY
	help
	  Supports kernel live patching without ftrace

endchoice

choice
	prompt "live patching consistency model"
	depends on LIVEPATCH
	default LIVEPATCH_PER_TASK_CONSISTENCY if LIVEPATCH_FTRACE
	default LIVEPATCH_STOP_MACHINE_CONSISTENCY if LIVEPATCH_WO_FTRACE
	help
	  Livepatch consistency model configuration.

config LIVEPATCH_PER_TASK_CONSISTENCY
	bool "per task consistency"
	depends on LIVEPATCH_FTRACE
	help
	  Use basic per-task consistency model
	  It's a hybrid of kGraft and kpatch:
	  uses kGraft's per-task consistency and syscall
	  barrier switching combined with kpatch's stack
	  trace switching. There are also a number of
	  fallback options which make it quite flexible.

config LIVEPATCH_STOP_MACHINE_CONSISTENCY
	bool "stop machine consistency"
	depends on LIVEPATCH_WO_FTRACE
	help
	  Use stop machine consistency model
	  stop-machine consistency and kpatch's stack
	  trace checking.

endchoice

config LIVEPATCH_STACK
	bool "Enforcing the patch stacking principle"
	depends on LIVEPATCH_FTRACE || LIVEPATCH_WO_FTRACE
	default y
	help
	  Say N here if you want to remove the patch stacking principle.

config LIVEPATCH_RESTRICT_KPROBE
	bool "Enforing check livepatch and kprobe restrict"
	depends on LIVEPATCH_WO_FTRACE
	depends on KPROBES
	default y
	help
	  Livepatch without ftrace and kprobe are conflicting.
	  We should not patch for the functions where registered with kprobe,
	  and vice versa.
	  Say Y here if you want to check those.

config LIVEPATCH_BREAKPOINT_NO_STOP_MACHINE
	bool "No stop_machine in breakpoint optimization mode"
	depends on LIVEPATCH_WO_FTRACE
	default n
	help
	  In breakpoint optimization mode, check tasks calltrace
	  in batches without using stop machine so that reduce the
	  service downtime.
	  Say N if you are unsure.

endmenu
endif
```
