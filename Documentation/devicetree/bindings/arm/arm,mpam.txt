## arch/sw_64/kvm/Kconfig
```kconfig
# SPDX-License-Identifier: GPL-2.0
#
# KVM configuration
#
source "virt/kvm/Kconfig"

menuconfig VIRTUALIZATION
	bool "Virtualization"
	help
	  Say Y here to get to see options for using your Linux host to run
	  other operating systems inside virtual machines (guests).
	  This option alone does not add any kernel code.

	  If you say N, all options in this submenu will be skipped and disabled.

if VIRTUALIZATION

config KVM
	tristate "Kernel-based Virtual Machine (KVM) support"
	select KVM_SW64_HOST
	select PREEMPT_NOTIFIERS
	select CMA
	depends on NET
	select HAVE_KVM_EVENTFD
	select HAVE_KVM_IRQCHIP
	select HAVE_KVM_IRQ_ROUTING
	select HAVE_KVM_IRQFD
	select HAVE_KVM_MSI
	select KVM_VFIO
	select TUN
	select GENERIC_ALLOCATOR
	help
	  Support for hosting Guest kernels.
	  We don't support KVM with 3-level page tables yet.

	  If unsure, say N.

config KVM_SW64_HOST
	tristate "KVM for SW64 processors support"
	depends on KVM
	help
	  Provides host support for SW64 processors.
	  To compile this as a module, choose M here.

config KVM_MEMHOTPLUG
	bool "Memory hotplug support for guest"
	depends on KVM && MEMORY_HOTPLUG
	help
	  Provides memory hotplug support for SW64 guest.


source "drivers/vhost/Kconfig"

endif # VIRTUALIZATION
```

## block/blk-io-hierarchy/Kconfig
```kconfig
# SPDX-License-Identifier: GPL-2.0-only

menuconfig BLK_IO_HIERARCHY_STATS
	bool "Enable hierarchy io stats"
	default n
	depends on BLK_DEBUG_FS=y
	help
	Enabling this lets the block layer to record additional information
	in different io stages. Such information can be helpful to debug
	performance and problems like io hang.

	If unsure, say N.

if BLK_IO_HIERARCHY_STATS

config HIERARCHY_BIO
	bool "Support to record stats for bio lifetime"
	default n
	select BLK_BIO_ALLOC_TIME
	help
	Enabling this lets blk hierarchy stats to record additional information
	for bio. Such information can be helpful to debug performance and
	problems like io hang.

	If unsure, say N.

config HIERARCHY_IO_DUMP
	bool "Support to dump io that is throttled"
	default n
	select BLK_BIO_ALLOC_TIME
	select BLK_BIO_ALLOC_TASK
	depends on BLK_DEV_IO_TRACE
	help
	Enable this will create new debugfs entries to show user the detailed
	information of IO that are submitted and not done yet, and user can
	filter the result by IO stage or IO latency.

	If unsure, say N.

config HIERARCHY_THROTTLE
	bool "Enable hierarchy stats layer blk-throttle"
	default n
	depends on BLK_DEV_THROTTLING=y
	help
	Enabling this lets blk hierarchy stats to record additional information
	for blk-throttle. Such information can be helpful to debug performance
	and problems like io hang.

	If unsure, say N.

config HIERARCHY_WBT
	bool "Enable hierarchy stats layer blk-wbt"
	default n
	depends on BLK_WBT
	help
	Enabling this lets blk hierarchy stats to record additional information
	for blk-wbt. Such information can be helpful to debug performance
	and problems like io hang.

	If unsure, say N.

config HIERARCHY_GETTAG
	bool "Enable hierarchy stats layer gettag"
	default n
	help
	Enabling this lets blk hierarchy stats to record additional information
	for gettag. Such information can be helpful to debug performance
	and problems like io hang.

	If unsure, say N.

config HIERARCHY_PLUG
	bool "Enable hierarchy stats layer plug"
	default n
	help
	Enabling this lets blk hierarchy stats to record additional information
	for plug. Such information can be helpful to debug performance
	and problems like io hang.

	If unsure, say N.

config HIERARCHY_DEADLINE
	bool "Enable hierarchy stats layer mq-deadline"
	default n
	depends on MQ_IOSCHED_DEADLINE
	help
	Enabling this lets blk hierarchy stats to record additional information
	for mq-deadline. Such information can be helpful to debug performance
	and problems like io hang.

	If unsure, say N.

config HIERARCHY_BFQ
	bool "Enable hierarchy stats layer bfq"
	default n
	depends on IOSCHED_BFQ
	help
	Enabling this lets blk hierarchy stats to record additional information
	for bfq. Such information can be helpful to debug performance
	and problems like io hang.

	If unsure, say N.

config HIERARCHY_KYBER
	bool "Enable hierarchy stats layer kyber"
	default n
	depends on MQ_IOSCHED_KYBER
	help
	Enabling this lets blk hierarchy stats to record additional information
	for kyber. Such information can be helpful to debug performance
	and problems like io hang.

	If unsure, say N.

config HIERARCHY_HCTX
	bool "Enable hierarchy stats layer hctx"
	default n
	help
	Enabling this lets blk hierarchy stats to record additional information
	for hctx. Such information can be helpful to debug performance
	and problems like io hang.

	If unsure, say N.

config HIERARCHY_REQUEUE
	bool "Enable hierarchy stats layer requeue"
	default n
	help
	Enabling this lets blk hierarchy stats to record additional information
	for requeue. Such information can be helpful to debug performance
	and problems like io hang.

	If unsure, say N.

config HIERARCHY_RQ_DRIVER
	bool "Enable hierarchy stats layer rq_driver"
	default n
	help
	Enabling this lets blk hierarchy stats to record additional information
	for rq_driver. Such information can be helpful to debug performance
	and problems like io hang.

	If unsure, say N.

endif
```

## drivers/arm/spe/Kconfig
```kconfig
# SPDX-License-Identifier: GPL-2.0-only
#
# arm spe dirver
#
config ARM_SPE_MEM_SAMPLING
	bool "In-kernel SPE for driver for page access profiling"
	depends on ARM64
        help
	  Enable support for the ARMv8.2 Statistical Profiling Extension, which
	  provides periodic sampling of operations in the CPU pipeline.
```

## drivers/clk/hisilicon/Kconfig
```kconfig
# SPDX-License-Identifier: GPL-2.0-only
config COMMON_CLK_HI3516CV300
	tristate "HI3516CV300 Clock Driver"
	depends on ARCH_HISI || COMPILE_TEST
	select RESET_HISI
	default ARCH_HISI
	help
	  Build the clock driver for hi3516cv300.

config COMMON_CLK_HI3519
	tristate "Hi3519 Clock Driver"
	depends on ARCH_HISI || COMPILE_TEST
	select RESET_HISI
	default ARCH_HISI
	help
	  Build the clock driver for hi3519.

config COMMON_CLK_HI3660
	bool "Hi3660 Clock Driver"
	depends on ARCH_HISI || COMPILE_TEST
	default ARCH_HISI
	help
	  Build the clock driver for hi3660.

config COMMON_CLK_HI3531DV200
	tristate "Hi3531DV200 Clock Driver"
	depends on ARCH_HI3531DV200 || COMPILE_TEST
	select RESET_HISI
	default ARCH_HISI_BVT
	help
	  Build the clock driver for Hi3531DV200.

config COMMON_CLK_HI3535AV100
	tristate "Hi3535AV100 Clock Driver"
	depends on ARCH_HI3535AV100 || COMPILE_TEST
	select RESET_HISI
	default ARCH_HISI_BVT
	help
	  Build the clock driver for Hi3535AV100.

config COMMON_CLK_HI3521DV200
	tristate "Hi3521DV200 Clock Driver"
	depends on ARCH_HI3521DV200 || COMPILE_TEST
	select RESET_HISI
	default ARCH_HISI_BVT
	help
	  Build the clock driver for hi3521DV200.

config COMMON_CLK_HI3520DV500
	tristate "Hi3520DV500 Clock Driver"
	depends on ARCH_HI3520DV500 || COMPILE_TEST
	select RESET_HISI
	default ARCH_HISI_BVT
	help
	  Build the clock driver for hi3520DV500.

config COMMON_CLK_HI3670
	bool "Hi3670 Clock Driver"
	depends on ARCH_HISI || COMPILE_TEST
	default ARCH_HISI
	help
	  Build the clock driver for hi3670.

config COMMON_CLK_HI3798CV200
	tristate "Hi3798CV200 Clock Driver"
	depends on ARCH_HISI || COMPILE_TEST
	select RESET_HISI
	default ARCH_HISI
	help
	  Build the clock driver for hi3798cv200.

config COMMON_CLK_HI3516A
	tristate "Hi3516A Clock Driver"
	depends on ARCH_HI3516A || COMPILE_TEST
	select RESET_HISI
	default ARCH_HISI
	help
	  Build the clock driver for hi3516A.

config COMMON_CLK_HI3516CV500
	tristate "Hi3516CV500 Clock Driver"
	depends on ARCH_HI3516CV500 || COMPILE_TEST
	select RESET_HISI
	default ARCH_HISI_BVT
	help
	  Build the clock driver for hi3516CV500.

config COMMON_CLK_HI3516EV200
	tristate "Hi3516EV200 Clock Driver"
	depends on ARCH_HI3516EV200 || COMPILE_TEST
	select RESET_HISI
	default ARCH_HISI
	help
	  Build the clock driver for hi3516EV200.

config COMMON_CLK_HI3516EV300
	tristate "Hi3516EV300 Clock Driver"
	depends on ARCH_HI3516EV300 || COMPILE_TEST
	select RESET_HISI
	default ARCH_HISI
	help
	  Build the clock driver for hi3516EV300.

config COMMON_CLK_HI3518EV300
	tristate "Hi3518EV300 Clock Driver"
	depends on ARCH_HI3518EV300 || COMPILE_TEST
	select RESET_HISI
	default ARCH_HISI
	help
	  Build the clock driver for hi3518EV300.

config COMMON_CLK_HI3516DV200
	tristate "Hi3516DV200 Clock Driver"
	depends on ARCH_HI3516DV200 || COMPILE_TEST
	select RESET_HISI
	default ARCH_HISI
	help
	  Build the clock driver for hi3516DV200.

config COMMON_CLK_HI3516DV300
	tristate "Hi3516DV300 Clock Driver"
	depends on ARCH_HI3516DV300 || COMPILE_TEST
	select RESET_HISI
	default ARCH_HISI_BVT
	help
	  Build the clock driver for hi3516DV300.

config COMMON_CLK_HI3556V200
	tristate "Hi3556V200 Clock Driver"
	depends on ARCH_HI3556V200 || COMPILE_TEST
	select RESET_HISI
	default ARCH_HISI_BVT
	help
	  Build the clock driver for hi3556V200.

config COMMON_CLK_HI3559V200
	tristate "Hi3559V200 Clock Driver"
	depends on ARCH_HI3559V200 || COMPILE_TEST
	select RESET_HISI
	default ARCH_HISI_BVT
	help
	  Build the clock driver for hi3559V200.

config COMMON_CLK_HI3562V100
	tristate "Hi3562V100 Clock Driver"
	depends on ARCH_HI3562V100 || COMPILE_TEST
	select RESET_HISI
	default ARCH_HISI_BVT
	help
	  Build the clock driver for hi3562V100.

config COMMON_CLK_HI3566V100
	tristate "Hi3566V100 Clock Driver"
	depends on ARCH_HI3566V100 || COMPILE_TEST
	select RESET_HISI
	default ARCH_HISI_BVT
	help
	  Build the clock driver for hi3566V100.

config COMMON_CLK_HI3518EV20X
	tristate "Hi3518EV20X Clock Driver"
	depends on ARCH_HI3518EV20X || COMPILE_TEST
	select RESET_HISI
	default ARCH_HISI_BVT
	help
	  Build the clock driver for hi3516A.

config COMMON_CLK_HI3536DV100
	tristate "Hi3536DV100 Clock Driver"
	depends on ARCH_HI3536DV100 || COMPILE_TEST
	select RESET_HISI
	default ARCH_HISI
	help
	  Build the clock driver for hi3536DV100.

config COMMON_CLK_HI3559AV100
	tristate "Hi3559AV100 Clock Driver"
	depends on ARCH_HI3559AV100 || COMPILE_TEST
	select RESET_HISI
	default ARCH_HISI_BVT
	help
	  Build the clock driver for hi3559av100.

config COMMON_CLK_HI3569V100
	tristate "Hi3569V100 Clock Driver"
	depends on ARCH_HI3569V100 || COMPILE_TEST
	select RESET_HISI
	default ARCH_HISI_BVT
	help
	  Build the clock driver for hi3569v100.

config COMMON_CLK_HI3521A
	tristate "Hi3521A Clock Driver"
	depends on ARCH_HI3521A || COMPILE_TEST
	select RESET_HISI
	default ARCH_HISI_BVT
	help
	  Build the clock driver for hi3521A.

config COMMON_CLK_HI3531A
	tristate "Hi3531A Clock Driver"
	depends on ARCH_HI3531A || COMPILE_TEST
	select RESET_HISI
	default ARCH_HISI_BVT
	help
	  Build the clock driver for hi3531A.

config COMMON_CLK_HI3556AV100
	tristate "Hi3556AV100 Clock Driver"
	depends on ARCH_HI3556AV100 || COMPILE_TEST
	select RESET_HISI
	default ARCH_HISI
	help
	  Build the clock driver for hi3556av100.

config COMMON_CLK_HI3519AV100
	tristate "Hi3519AV100 Clock Driver"
	depends on ARCH_HI3519AV100 || COMPILE_TEST
	select RESET_HISI
	default ARCH_HISI
	help
	  Build the clock driver for hi3519av100.

config COMMON_CLK_HI3568V100
	tristate "Hi3568V100 Clock Driver"
	depends on ARCH_HI3568V100 || COMPILE_TEST
	select RESET_HISI
	default ARCH_HISI
	help
	  Build the clock driver for hi3568v100.

config COMMON_CLK_HI6220
	bool "Hi6220 Clock Driver"
	depends on ARCH_HISI || COMPILE_TEST
	default ARCH_HISI
	help
	  Build the Hisilicon Hi6220 clock driver based on the common clock framework.

config RESET_HISI
	bool "HiSilicon Reset Controller Driver"
	depends on ARCH_HISI || COMPILE_TEST || ARCH_HISI_BVT
	select RESET_CONTROLLER
	help
	  Build reset controller driver for HiSilicon device chipsets.

config STUB_CLK_HI6220
	bool "Hi6220 Stub Clock Driver" if EXPERT
	depends on (COMMON_CLK_HI6220 || COMPILE_TEST)
	depends on MAILBOX
	default COMMON_CLK_HI6220
	help
	  Build the Hisilicon Hi6220 stub clock driver.

config STUB_CLK_HI3660
	bool "Hi3660 Stub Clock Driver" if EXPERT
	depends on (COMMON_CLK_HI3660 || COMPILE_TEST)
	depends on MAILBOX
	default COMMON_CLK_HI3660
	help
	  Build the Hisilicon Hi3660 stub clock driver.
```
