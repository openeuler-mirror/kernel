## Documentation/devicetree/bindings/arm/arm,mpam.txt
```
Memory System Resource Partitioning and Monitoring (MPAM), for Armv8-A
----------------------------------------------------------

The MPAM is used to limit memory bandwidth and cache usage for ARM platform.
The required properties for driver is:
	compatible = "arm,mpam";  /* MPAM for Arm */
	reg = <>; /* mpam device base register */

The property type must be included, it is used to indicate type of mpam
device for the node. There are several type of mpam device:
	MPAM_CLASS_SMMU = 0,
	MPAM_CLASS_CACHE,   /* Well known caches, e.g. L2 */
	MPAM_CLASS_MEMORY,  /* Main memory */
	MPAM_CLASS_UNKNOWN, /* Everything else, e.g. TLBs etc */

The type of memory is set as:
	type = <2>;
The type of cache is set as:
	type = <1>;

MPAM support interrupt for error and overflow, the error-interrupt and
overflow-interrupt are defined in "Memory System Resource Partitioning
and Monitoring (MPAM), for Armv8-A", MPAM interrupts(section 8.8).
	overflow-interrupt = <0>;
	overflow-flags = <0>;
	error-interrupt = <0>;
	error-interrupt-flags = <0>;

Example:

mpam {
	compatible = "arm,mpam";

	mpam_memory0 {
		reg = <0x0 0x10000000 0x0 0x10000>;
		type = <2>; /* memory type */
		numa-node-id = <0>;
		overflow-interrupt = <0>;
		overflow-flags = <0>;
		error-interrupt = <0>;
		error-interrupt-flags = <0>;
		not-ready-max = <0>;
	};

	mpam_cache0 {
		reg = <0x0 0x20000000 0x0 0x10000>;
		type = <1>; /* cache type */
		cache-id = <0>;
		cache-level = <3>;
		overflow-interrupt = <0>;
		overflow-flags = <0>;
		error-interrupt = <0>;
		error-interrupt-flags = <0>;
		not-ready-max = <0>;
	};

};
```

## Documentation/devicetree/bindings/arm/cpus.yaml
```yaml
# SPDX-License-Identifier: (GPL-2.0 OR BSD-2-Clause)
%YAML 1.2
---
$id: "http://devicetree.org/schemas/arm/cpus.yaml#"
$schema: "http://devicetree.org/meta-schemas/core.yaml#"

title: CPUS, a container for CPU subnodes

description: |
  The device tree allows to describe the layout of CPUs in a system through
  the "cpus" node, which in turn contains a number of subnodes (ie "cpu")
  defining properties for every CPU.

  Properties of the CPU integration that are common to all CPUs can be described
  in the cpus node.

  ARM CPUs with the FEAT_HPDS2 feature allow an IMPLEMENTATION DEFINED
  hardware attribute to be encoded in the leaf page table entries and
  sent with any transaction that makes an access via that entry.

  Four bits are used in the page-tables. It is likely the individual bits will
  be combined and used a a four bit value. The impact of any particular value is
  up to the implementation.

  0 is defined as a 'safe default setting' that behaves as if the feature
  were not implemented. Other values may be unsafe, having coherency or
  correctness issues leading to data-corruption or deadlock.

  This binding lists the additional values that only have a performance cost
  (or benefit), and values that can only be used if all mappings have the same
  PBHA value.
  For both cases, all affected values should be listed. If setting bit-2
  requires no aliases, then the values 2, 4, 6 etc should be listed.

  A hypervisor can only control individual bits, and may choose to only enable
  bits that can only be used to build other performance-only values.
  e.g. the value 5 is listed, but enabling bit-0 and bit-2 would allow a guest
  to configure the values 1 or 4 too. If these 'decomposed' values only
  affected performance, they should also be listed.

  The list does not need to be in numeric order, but a hypervisor may make use
  of the order when enabling bits.

  The presence of a 'arm,pbha-no-aliases' property indicates that higher
  exception levels and secure-world firmware do not have a mapping of any memory
  in the memory node or UEFI memory map, other than those with a reserved-memory
  entry or EFIReserved memory attribute.
  Firmware mappings created based on requests from the normal world do not use
  any of the arm,pbha-no-aliases values, or take the PBHA value to use as an
  argument.

properties:
  $nodename:
    const: cpus

  arm,pbha-performance-only:
    $ref: /schemas/types.yaml#/definitions/uint8-array
    description: PBHA values that only affect performance
    minItems: 1
    maxItems: 15
    items:
      maximum: 15

  arm,pbha-no-aliases:
    $ref: /schemas/types.yaml#/definitions/uint8-array
    description: PBHA values that must only be used if all mappings have the
                   same value.
    minItems: 1
    maxItems: 15
    items:
      maximum: 15


additionalProperties: true

examples:
  -|
  /{
    cpus {
      arm,pbha-performance-only = /bits/ 8 <0x01 0x05 0x09>;
      arm,pbha-no-aliases = /bits/ 8 <0x02 0x04 0x06 0x08>;

      cpu@0 {
        device_type = "cpu";
        compatible = "arm,cortex-a57";
        ...
      };

    };
  };
...
```

## Documentation/devicetree/bindings/gpu/phytium,dc.yaml
```yaml
# SPDX-License-Identifier: (GPL-2.0-only OR BSD-2-Clause)
%YAML 1.2
---
$id: http://devicetree.org/schemas/dc/snps,dc.yaml#
$schema: http://devicetree.org/meta-schemas/core.yaml#

title: Phytium Display Controller

maintainers:
  - Chen Baozi <chenbaozi@phytium.com.cn>

allOf:
  - $ref: /schemas/dc/display-controller.yaml#

properties:
  compatible:
    const: phytium,dc

  reg:
    minItems: 1
    items:
      - description: Offset and length of the memory mapped registers

  interrupts:
    maxItems: 1

  clocks:
    minItems: 1
    items:
      - description:Display controller reference clock source

unevaluatedProperties: false

required:
  - compatible
  - reg
  - interrupts

Example:
       /memreserve/ 0xf4000000 0x4000000; // (optional)

       dc0@32000000 {
               compatible = "phytium,dc";
               reg = <0x0 0x32000000 0x0 0x8000>,
                     <0x0 0xf4000000 0x0 0x4000000>; // (optional)
               interrupts = <GIC_SPI 44 IRQ_TYPE_LEVEL_HIGH>;
               pipe_mask = 0x3
               edp_mask = 0x0;
       };
```

## Documentation/devicetree/bindings/gpu/phytium-display.txt
```
* Phytium Display Engine

Required properties:
  - compatible : value should be "phytium,dc".
  - reg : first reg: Physical base address of the registers and length of memory
	  mapped region.
	  second reg (optional): Physical base address and length of video memory which is reserved system memory.
  - interrupts : interrupt number.
  - pipe_mask : specify which pipe is enabled, each bit corresponds to a pipe.
  - edp_mask : specify which pipe is edp port, each bit corresponds to a pipe (0:dp, 1:edp).

Example:
	/memreserve/ 0xf4000000 0x4000000; // (optional)

	dc0@32000000 {
		compatible = "phytium,dc";
		reg = <0x0 0x32000000 0x0 0x8000>,
		      <0x0 0xf4000000 0x0 0x4000000>; // (optional)
		interrupts = <GIC_SPI 44 IRQ_TYPE_LEVEL_HIGH>;
		pipe_mask = 0x3
		edp_mask = 0x0;
	};
```

## Documentation/devicetree/bindings/i2c/i2c-phytium.txt
```
* Phytium I2C/SMBus controller

Required properties :

 - compatible : should be "phytium,i2c"
 - reg : Offset and length of the register set for the device
 - interrupts : <IRQ> where IRQ is the interrupt number.
 - clock-frequency : desired I2C bus clock frequency in Hz.

Optional properties:

 - interrupt-names: should be "smbus_alert" if SMBus alert
		    interrupt is supported.

Examples :

	i2c0: i2c@28011000 {
		compatible = "phytium,i2c";
		reg = <0x0 0x28011000 0x0 0x1000>;
		interrupts = <GIC_SPI 89 IRQ_TYPE_LEVEL_HIGH>;
		interrupt-names = "smbus_alert";
		clocks = <&sysclk_48mhz>;
	};
```

## Documentation/devicetree/bindings/mmc/hi3xxx-dw-mshc.txt
```
* Hisilicon specific extensions for Synopsys DW Memory Card
  Storage Host Controller

Read hi3xxx-dw-mshc.txt for more details

The Synopsys designware storage host controller is used to interface
a SoC with storage medium such as eMMC or SD/MMC cards. This file documents
differences between the core Synopsys dw mshc hi3xxx controller properties described
by hi3xxx-dw-mshc.txt and the properties used by the Hisilicon hi3xxx
specific extensions to the Synopsys Designware Storage Host Controller.

Required Properties:
- compatible: Should contain "hisilicon,davinci-dw-mshc".
- customized: Should have this property.

Example:

        dwmmc0: dwmmc0@10CF90000 {
                compatible = "hisilicon,davinci-dw-mshc";
                reg = <0x1 0x0CF90000 0x0 0x1000>,
                          <0x1 0x0c000000 0x0 0x10000>,
                          <0x1 0x100c0000 0x0 0x10000>;
                interrupts = <0 39 4>;
                customized;
                num-slots = <1>;
                fifo-depth = <0x100>;
                card-detect-delay = <200>;
                broken-cd;
                non-removable;
                supports-highspeed;
                caps2-mmc-hs200-1_8v;
                caps2-mmc-cache-ctrl;
                keep-power-in-suspend;
                caps2-mmc-bkops_auto-ctrl;
                pinctrl-names = "default", "idle";
        }
```

## Documentation/devicetree/bindings/mmc/phytium,sdci.txt
```
Phytium SD Host controller

The SD Host Controller on Phytium SoCs provides an interface
for SD and SDIO types of memory cards.

Required properties:
- compatible : should be "phytium,mci".
- reg: mmc controller base registers.
- interrupts : mmc controller interrupt.
- clocks : phandles to input clocks.
- clock-names : should be "phytium_mci_clk".

Examples:
	sdci: sdci@28207c00 {
		compatible = "phytium,sdci";
		reg = <0x0 0x28207c00 0x0 0x100>;
		interrupts = <GIC_SPI 20 IRQ_TYPE_LEVEL_HIGH>,
			     <GIC_SPI 21 IRQ_TYPE_LEVEL_HIGH>,
			     <GIC_SPI 22 IRQ_TYPE_LEVEL_HIGH>;
		clocks = <&sysclk_600mhz>;
		clock-names = "phytium_sdc_clk";
	};
```

## Documentation/devicetree/bindings/mtd/phytium,qspi.txt
```
* Phytium Quad Serial Peripheral Interface (QSPI)

Required properties:
- compatible: should be "phytium,qspi"
- reg: the first contains the register
       the second contains the memory mapping region
- reg-names: should contain the reg names "qspi" "qspi_mm"
- clocks: the phandle of the clock needed by the QSPI controller

Optional property:
- reg: chip-Select number
- spi-max-frequency: max frequency of spi bus
- spi-rx-bus-width: see ../spi/spi-bus.txt for the description

Example:

qspi@28014000 {
	compatible = "phytium,qspi";
	reg = <0x0 0x28014000 0x0 0x1000 0x0 0x0 0x0 0x10000000>;
	reg-names = "qspi", "qspi_mm";
	clocks = <0x4>;
	status = "ok";

	flash0@0 {
		spi-rx-bus-width = <0x1>;
		spi-max-frequency = <0x23c34600>;
	};

	flash1@0 {
		reg = <0x1>;
		spi-rx-bus-width = <0x1>;
		spi-max-frequency = <0x23c34600>;
	};

	flash2@0 {
		reg = <0x2>;
		spi-rx-bus-width = <0x1>;
		spi-max-frequency = <0x23c34600>;
	};
};
```

## Documentation/devicetree/bindings/net/can/phytium,can.yaml
```yaml
# SPDX-License-Identifier: (GPL-2.0-only OR BSD-2-Clause)
%YAML 1.2
---
$id: http://devicetree.org/schemas/net/can/phytium,can.yaml#
$schema: http://devicetree.org/meta-schemas/core.yaml#

title: Phytium CAN Controller

maintainers:
  - Chen Baozi <chenbaozi@phytium.com.cn>

allOf:
  - $ref: /schemas/net/can/phytium/phytium,can.yaml#

properties:
  compatible:
    oneOf:
      - item:
          -const: phytium,can
          - const: phytium,canfd

  reg:
    minItems: 1
    items:
      - description: Should contain CANFD controller registers location and length

  interrupts:
    maxItems: 1

  clocks:
    minItems: 1
    items:
      - description: CLocks used by the controller

  clock-names:
    items:
      - const: can_clk

required:
  - compatible
  - reg
  - interrupts

examples:
  - |
	 can0: can@2800a000{
		 compatible = "phytium,canfd";
		 reg = <0x0 0x2800a000 0x0 0x1000>;
		 interrupts = <GIC_SPI 81 IRQ_TYPE_LEVEL_HIGH>;
		 clocks = <&sysclk_600mhz>;
		 clock-names = "can_clk";
		 tx-fifo-depth = <64>;
		 rx-fifo-depth = <64>;
	 };
...
```

## Documentation/devicetree/bindings/net/dwmac-phytium.txt
```
Phytium 10/100/1000 Ethernet driver(GMAC)

The device node has following properties.

Required properties:
 - compatible: should be "phytium,gmac"
 - reg: addresses and length of the register sets for the device.
 - interrupts: Should contain the GMAC interrupts.
 - phy-mode: See ethernet.txt file in the same directory.
 - clock-frequency: the frequecy of the clock.

Example:
gmac0: eth@2820c000 {
	compatible = "phytium,gmac";
	reg = <0x0 0x2820c000 0x0 0x2000>;
	interrupts = <GIC_SPI 49 IRQ_TYPE_LEVEL_HIGH>;
	status = "disabled";
	phy-mode = "rgmii-txid";
	clock-frequency = <250000000>;

	snps,pbl = <16>;
	snps,fixed-burst;
	snps,multicast-filter-bins = <64>;
	snps,perfect-filter-entries = <128>;
	tx-fifo-depth = <4096>;
	rx-fifo-depth = <4096>;
	max-frame-size = <9000>;
};
```

## Documentation/devicetree/bindings/perf/hisi-l3t-pmu.txt
```
Hisilicon L3T PMU comtrollers

Required properties:
  - compatible : should be "hisilicon,l3t-pmu".
  - reg : should contain at least address and length of the L3T PMU
    register set for the device.
  - interrupts : one L3T interrupt should be described here.

Example
    l3t0@81170000 {
        compatible = "hisilicon,l3t-pmu";
        hisilicon,scl-id = <1>;
        hisilicon,ccl-id = <0>;
        hisilicon,index-id = <1>;
        reg = <0x0 0x81170000 0x0 0x10000>;
        interrupts = <0x0 316 0x4>;
    };
```

## Documentation/devicetree/bindings/perf/hisi-lpddrc-pmu.txt
```
Hisilicon LPDDRC PMU comtrollers

Required properties:
  - compatible : should be "hisilicon,lpddrc-pmu".
  - reg : should contain at least address and length of the LPDDRC PMU
    register set for the device.
  - interrupts : one LPDDRC interrupt should be described here.

Example
    lpddrc0@A5800000 {
        compatible = "hisilicon,lpddrc-pmu";
        hisilicon,ch-id = <0>;
        hisilicon,scl-id = <1>;
        reg = <0x0 0xA5800000 0x0 0x10000>;
        interrupts = <0x0 32 0x4>;
    };
```

## Documentation/devicetree/bindings/rtc/phytium,rtc.txt
```
# SPDX-License-Identifier: (GPL-2.0-only OR BSD-2-Clause)
%YAML 1.2
---
$id: http://devicetree.org/schemas/rtc/phytium,rtc.yaml#
$schema: http://devicetree.org/meta-schemas/core.yaml#

title: Phytium Real Time Clock

select:
  properties:
    compatible:
     contains:
        const: phytium,rtc
  required:
    - compatible

allOf:
  - $ref: rtc.yaml#

maintainers:
  - Chen Baozi <chenbaozi@phytium.com.cn>

properties:
  compatible:
    items:
      - const: phytium,rtc

  reg:
    maxItems: 1

  interrupts:
    maxItems: 1

  clocks:
    maxItems: 1

  start-year: true

required:
  - compatible
  - reg
  - interrupts
  - clocks

additionalProperties: false

examples:
  - |
    rtc@2800d0000 {
        compatible = "phytium,rtc";
        reg = <0x0 0x2800d000 0x0 0x1000>;
        interrupts = <GIC_SPI 4 IRQ_TYPE_LEVEL_HIGH>;
        clocks = <&sysclk_48mhz>;
    };
```

## Documentation/devicetree/bindings/sound/phytium-hda.txt
```
* Phytium HDA controller

The HDA bus (High Definition Audio sound bus) is a serial link for digital
audio data transfer between devices in the system.

Required properties:

- compatible: should be "phytium,hda"
- reg: physical base address and length of HDA controller.
- interrupts: interrupt for the hda controller.
- clocks: phandle to clock provider with the clock number in the second cell.
- clock-name: the name of the device clock.

Example for D2000 HDA controller:

hda: hda@28206000 {
	compatible = "phytium,hda";
	reg = <0 0x28206000 0x0 0x1000>;
	interrupts = <GIC_SPI 23 IRQ_TYPE_LEVEL_HIGH>;
	clocks = <&sysclk_48mhz>;
	clock-names = "phytium_hda_clk";
};
```
