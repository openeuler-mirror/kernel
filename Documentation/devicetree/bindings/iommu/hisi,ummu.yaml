## Documentation/devicetree/bindings/iommu/hisi,ummu.yaml
```yaml
# SPDX-License-Identifier: (GPL-2.0-only OR BSD-2-Clause)
%YAML 1.2
---
$id: http://devicetree.org/schemas/iommu/hisi,ummu.yaml#
$schema: http://devicetree.org/meta-schemas/core.yaml#

title: HiSilicon UMMU Architecture Implementation

maintainers:
  - Jingbin Wu <wujingbin2@huawei.com>

description: |+
  UMMU is an IOMMU device that performs address translation and permission checking
  using DstEID, TokenID, and UBA as input parameters.

properties:
  $nodename:
    pattern: "^ummu@[0-9a-f]*"
  compatible:
    const: ub,ummu
  index:
    $ref: /schemas/types.yaml#/definitions/uint32
    description: |
      UMMU device index. Used to identify a specific UMMU instance in systems
      with multiple UMMU devices.
  msi-parent:
    $ref: /schemas/types.yaml#/definitions/phandle
    description: |
      MSI parent device phandle. Required for MSI interrupt handling.
  interrupt-affinity:
    $ref: /schemas/types.yaml#/definitions/phandle-array
    items:
      maxItems: 1
    description: |
      Specifies a list of phandles to CPU nodes to which the UMMU event queue
      and global error interrupts should be affine. The syntax is the same as
      the ``interrupt-affinity`` property of the ARM PMU binding, i.e. each
      entry is a single phandle without additional arguments, but the
      semantics differ: entries are not matched to individual interrupts,
      and all listed CPUs form one CPU mask which is applied to both
      interrupts. When omitted, the default interrupt placement is used.

required:
  - compatible
  - index
  - msi-parent

additionalProperties: false

examples:
  - |+
    ummu@0 {
        compatible = "ub,ummu";
        index = <0x0>;
        msi-parent = <&its>;
        interrupt-affinity = <&cpu1>, <&cpu3>;
    };
```

## Documentation/devicetree/bindings/perf/hisi,ummu-pmu.yaml
```yaml
# SPDX-License-Identifier: (GPL-2.0-only OR BSD-2-Clause)
%YAML 1.2
---
$id: http://devicetree.org/schemas/perf/hisi,ummu-pmu.yaml#
$schema: http://devicetree.org/meta-schemas/core.yaml#

title: HiSilicon UMMU Performance Monitor Unit (PMU)

maintainers:
  - Jingbin Wu <wujingbin2@huawei.com>

description: |
  The UMMU includes a PMU(Performance Monitor Unit ) to monitor and collect
  statistics on key hardware events, such as TLB/PLB cache hit rates and
  lookup latencies.

properties:
  $nodename:
    pattern: "^ummu-pmu@[0-9a-f]*"
  compatible:
    const: ub,ummu_pmu
  index:
    $ref: /schemas/types.yaml#/definitions/uint32
    description: |
      PMU device index. Identifies a specific UMMU-PMU instance in multi-UMMU-PMU
      systems.
  msi-parent:
    $ref: /schemas/types.yaml#/definitions/phandle
    description: |
      MSI parent device phandle. Required for MSI interrupt handling.
  interrupt-affinity:
    $ref: /schemas/types.yaml#/definitions/phandle-array
    items:
      maxItems: 1
    description: |
      Specifies a list of phandles to CPU nodes to which the PMU overflow
      interrupt should be affine. The syntax is the same as the
      ``interrupt-affinity`` property of the ARM PMU binding, i.e. each entry
      is a single phandle without additional arguments, but the semantics
      differ: entries are not matched to individual interrupts, and all
      listed CPUs form one CPU mask which is applied to the overflow
      interrupt. When omitted, the default interrupt placement is used.

required:
  - compatible
  - index
  - msi-parent

additionalProperties: false

examples:
  - |
    ummu-pmu@0 {
        compatible = "ub,ummu_pmu";
        index = <0x0>;
        msi-parent = <&its>;
        interrupt-affinity = <&cpu4>, <&cpu5>;
    };
```

## arch/arm64/Kconfig.turbo
```kconfig
# SPDX-License-Identifier: GPL-2.0-only
menu "Turbo features selection"

config FAST_SYSCALL
	bool "Fast syscall handler support"
	default n
	help
	  This enable support Fast syscall feature.
	  The svc exception handling process, which includes auxiliary
	  functions for debug/trace and core functions like
	  KPTI, has been identified as overly "lengthy".
	  This inefficiency is particularly noticeable in short syscalls
	  such as lseek() and getpid(), where the syscall function itself
	  comprises a small percentage of the total instructions executed.
	  To address this, we introduce the concept of fast syscall, a fast svc
	  exception handling path that only considers necessary features
	  such as security, context saving, and recovery.

config FAST_IRQ
	bool "Fast irq handler support"
	depends on ARM_GIC_V3
	default n
	help
	  The irq handling process, which includes auxiliary
	  functions for debug/trace and core functions like
	  KPTI, interrupt time record, interrupt processing as
	  a random number source, interrupt affinity
	  modification and interrupt processing race, as well as
	  spurious and unhandled interrupt debugging, has been
	  identified as overly "lengthy".
	  To address this, we introduce the concept of fast irq,
	  a fast interrupt handling path that only considers
	  necessary features such as security, context saving
	  and recovery, which adds an lightweight interrupt processing
	  framework for latency-sensitive interrupts.

config DEBUG_FEATURE_BYPASS
	bool "Bypass debug feature in fast syscall"
	depends on FAST_SYSCALL || FAST_IRQ
	depends on !LOCKDEP
	default n
	help
	  This to bypass debug feature in fast syscall.
	  The svc exception handling process, which includes auxiliary
	  functions for debug/trace and core functions like
	  KPTI, has been identified as overly "lengthy".
	  In fast syscall we only considers necessary features.
	  Disable this config to keep debug feature in fast syscall.

config SECURITY_FEATURE_BYPASS
	bool "Bypass security feature in fast syscall"
	depends on !ARM64_MTE
	depends on !KASAN_HW_TAGS
	depends on FAST_SYSCALL || FAST_IRQ
	default n
	help
	  This to bypass security feature in fast syscall.
	  The svc exception handling process, which includes auxiliary
	  functions for debug/trace and core functions like
	  KPTI, has been identified as overly "lengthy".
	  In fast syscall we only considers necessary features.
	  Disable this config to keep security feature in fast syscall.

config ACTLR_XCALL_XINT
	bool "Hardware XCALL and Xint support"
	depends on FAST_SYSCALL
	default n
	help
	  Use the 0x600 as the offset to the exception vector base address for
	  'svc ffff'
	  Use the 0x680 as the offset to the exception vector base address for
	  the Armv8.8 NMI taken from EL0.

config DYNAMIC_XCALL
	bool "Support dynamically replace and load system call"
	depends on FAST_SYSCALL
	depends on UPROBES
	default n
	help
	  Xcall 2.0 add "/proc/xcall/comm" interface to
	  attach xcall programs onto one executable,
	  and support different custom syscall implementation
	  by dynamic instruction replaced with 'svc ffff'
	  and a kernel module which provides customized
	  implementation.

config ARM64_COPY_FROM_USER_OPT
	bool "Hisilicon Optimized Copy From User enabled"
	depends on ARCH_HISI
	default y
	help
	  Enable an optimized copy_from_user implementation for
	  supported cores (e.g. Hisilicon HIP11, Hisilicon HIP12,
	  Linxicore9100). This trades a small PAN toggle overhead
	  for higher throughput on large copies. This can be
	  disabled at boot via copy_opt_disable.

config SMT_QOS
	bool "Support userspace timer/wft to reduce intra-core contention"
	depends on SCHED_SMT
	depends on FAST_IRQ
	depends on QOS_SCHED_DYNAMIC_AFFINITY
	depends on CFS_BANDWIDTH && CGROUP_SCHED
	select QOS_LEVEL
	default y
	help
	  Cloud Service Provider deploy Best-Effort and Latency Sensitive tasks
	  on the same physical core to maximize the resource utilization. We
	  observe the LS task needs more cycles to complete the same workload
	  due to the uarch resource contention. This feature control the
	  instruction throughput of BS task into pipeline, so that the other
	  SMT running LS task could occupy more uarch resources to reach better
	  IPC.

endmenu # "Turbo features selection"
```

## arch/arm64/mm/Kconfig
```kconfig
# SPDX-License-Identifier: GPL-2.0
#
# MEMORY configuration for arm64
#

config PFN_RANGE_ALLOC
	bool "Enable contiguous pfn range allocator"
	default n
	select CONTIG_ALLOC
	depends on MEMORY_HOTPLUG
	depends on ARM64_4K_PAGES || ARM64_64K_PAGES
	help
		It allows to allocate contiguous memory from special pfn range,
		the linear mapping granule of this range is never larger than PMD.

		If unsure, say N.

config TLBID_KUNIT_TEST
	bool "KUnit tests for TLBI" if !KUNIT_ALL_TESTS
	depends on KUNIT=y
	depends on ARM64_TLBID && ACPI
	default KUNIT_ALL_TESTS
	help
	  Enable this option to run tests for TLBID.

	  If unsure, say N.
```

## drivers/gpu/drm/engiant/Kconfig
```kconfig
# SPDX-License-Identifier: GPL-2.0
# Modified: 2026-04-07
#  - Disabled unused Kconfig options

config DRM_ENGIANT
	tristate "DRM Support for Engiant Display"
	depends on DRM && PCI
	select DRM_KMS_HELPER
	select DRM_VRAM_HELPER
	select DRM_TTM
	select DRM_TTM_HELPER
	select DRM_ENGIANT_VS
	select DRM_EGT_DP
	select ENGIANT_VS_PCIE
	help
	  Choose this option if you have an Engiant soc chipset.
	  This enables the DRM driver for the Engiant display subsystem,
	  which includes VeriSilicon DC and Engiant DP interface.

config DRM_ENGIANT_VS
	bool "DRM Support for VeriSilicon"
	depends on DRM_ENGIANT
	help
	  Choose this option if you have a VeriSilicon display controller.
	  This driver provides VeriSilicon kernel mode
	  setting and buffer management. It does not
	  provide 2D or 3D acceleration.

source "drivers/gpu/drm/engiant/connector/Kconfig"

config ENGIANT_VS_PCIE
	bool "PCIE driver support for VeriSilicon display controller"
	depends on DRM_ENGIANT_VS
	help
	  Choose this option if you want to register pcie driver for verisilicon display
	  controller, platform driver is used by default for veriSilicon display controller.
```

## drivers/gpu/drm/engiant/connector/Kconfig
```kconfig
# SPDX-License-Identifier: GPL-2.0

config DRM_EGT_DP
	bool "Egt display port driver"
	depends on DRM_ENGIANT
	select DRM_DISPLAY_HELPER
	help
	  Choose this option if you want to compile the Egt display driver,this driver is compile with verisilicon dc driver.
```

## drivers/infiniband/hw/nebula-matrix/Kconfig
```kconfig
# SPDX-License-Identifier: GPL-2.0
#
# Nebula-matrix RDMA driver configuration
#

config INFINIBAND_NBL
	tristate "Nebula-matrix RDMA driver"
	depends on NBL_CORE
	help
	  This driver provides RDMA support for
	  Nebula-matrix devices.
```

## drivers/infiniband/hw/nser/Kconfig
```kconfig
# SPDX-License-Identifier: GPL-2.0-only
config INFINIBAND_NSER
	tristate "WangXun Ethernet Protocol Driver for RDMA"
	depends on INET
	depends on IPV6 || !IPV6
	depends on PCI
	select GENERIC_ALLOCATOR
	select AUXILIARY_BUS
	help
	  This driver provides RDMA support for WangXun Ethernet
	  adapters. It registers an RDMA device with the IB core and
	  works together with the corresponding Ethernet driver to
	  offload RDMA operations.
```

## drivers/infiniband/hw/sxe2rdma/Kconfig
```kconfig
# SPDX-License-Identifier: GPL-2.0
#
# sxe2 network device configuration
#

config INFINIBAND_SXE2RDMA
	tristate "sxe2 network adapters RDMA support"
	depends on (X86 || ARM64)
	depends on NETDEVICES
	depends on ETHERNET
	depends on PCI
	depends on INET
	depends on IPV6
	depends on SXE2
	select AUXILIARY_BUS
	select CONFIGFS_FS
	default n
	help
	  This driver supports sxe2 PCI Express family of adapters.
	  To compile this driver as a module, choose M here.
```

## drivers/infiniband/hw/zrdma/Kconfig
```kconfig
# SPDX-License-Identifier: GPL-2.0

config INFINIBAND_ZRDMA
	tristate "ZTE Ethernet Protocol Driver for RDMA"
	depends on NET_VENDOR_DINGHAI && (X86 || ARM64)
	help
		This driver supports the ZTE Dinghai RDMA engine over PCIe,
		providing InfiniBand/RoCEv2 capabilities.

		To compile this driver as a module, choose M here: the module
		will be called zrdma.

		If unsure, say N.
```

## drivers/iommu/hisilicon/Kconfig
```kconfig
# SPDX-License-Identifier: GPL-2.0+
#
# Hisilicon UMMU support
#

source "drivers/iommu/hisilicon/ummu-core/Kconfig"
source "drivers/iommu/hisilicon/ubmem-mmu/Kconfig"

config UB_UMMU_BASE
	bool "Hisilicon UB MMU Support Builtin"
	depends on ARM64
	default n
	help
	  Support for implementations of the hisilicon UMMU architecture.
	  As the kernel provides the basic functionality for using UMMU features.
	  Say Y here if your Soc includes an UMMU device implementing
	  the Hisilicon UMMU architecture.

config UB_UMMU
	tristate "Hisilicon UB MMU Support"
	depends on ARM64 && ARCH_HISI
	depends on UB_UBUS && UB_UBFI
	default n
	select IOMMU_API
	select IOMMU_IO_PGTABLE_LPAE
	select GENERIC_MSI_IRQ
	select IOMMUFD_DRIVER if IOMMUFD
	select UB_UMMU_CORE
	select UB_UMMU_CORE_DRIVER
	select UB_UMMU_BASE
	help
	  Support for implementations of the hisilicon UMMU architecture.
	  UMMU provides address translation for device access to the
	  local host.
	  Say Y here if your Soc includes an UMMU device implementing
	  the Hisilicon UMMU architecture.

config UB_UMMU_SVA
	bool "Support for Shared Virtual Addressing with UMMU"
	depends on UB_UMMU
	select IOMMU_SVA
	select IOMMU_KSVA
	select IOMMU_IOPF
	default n
	help
	  Support for sharing process address spaces with devices using
	  the UMMU. And ummu provides access permission verification for
	  process address spaces.
	  Say Y here if your system supports SVA.

config UB_UBMEM_UMMU
	bool "Support UB memory's UMMU"
	depends on UB_UMMU
	default n
	help
	  Support the special UMMU for the address resolution of UB memory.
	  This is a private implementation. User must check the hardware
	  version.
	  If you need them say Y here.

config UB_UMMU_BYPASSDEV
	bool "Support UMMU to bypass device in S1"
	depends on UB_UMMU_BASE
	default n
	help
	  Support UMMU to bypass device. You need to add the parameter,
	  e.g."ummu.bypassdev=xxx(vendor):xxx(device)", to bypass a
	  certain type of device while starting OS. Subsequently, the device
	  will be bypassed, meaning IOVA = HPA(S1-only)/GPA(S1+S2).
	  If you need them say Y here.

config UB_UMMU_BYPASSEID
	bool "Support UMMU to bypass in EID granularity"
	depends on UMMU
	default n
	help
	  Support UMMU to bypass in EID granularity. When hardware
	  support is available and the config is enabled, stage 2
	  translation (GPA -> HPA) will be bypassed.
	  If you need them say Y here.
```

## drivers/iommu/hisilicon/ubmem-mmu/Kconfig
```kconfig
# SPDX-License-Identifier: GPL-2.0+
# Hisilicon UBMEM vIOMMU support
config UB_UBMEM_VMMU
	tristate "ubmem_vmmu driver"
	depends on UB_UMMU
	help
	   This option enables support for UBMEM_VMMU drivers. The
	   UBMEM_VMMU driver provides VMU device registration,
	   initialization, address mapping, and un-mapping inside
	   a VM.
```
