## drivers/iommu/hisilicon/ummu-core/Kconfig
```kconfig
# SPDX-License-Identifier: GPL-2.0+

config UB_UMMU_CORE
	bool "UMMU Framework Builtin API"
	depends on ARM64
	help
	  Enable the UMMU framework and configure this config, as the kernel
	  provides the basic functionality for using UB features. This config
	  is built-in by default if you are using UB features.
	  Say 'Y' here if you are using UB.

if UB_UMMU_CORE
config UB_UMMU_CORE_DRIVER
	tristate "UMMU Framework Modular API"
	depends on UB_UBUS
	help
	  The configuration is flexible and depends on how the ummu driver
	  intends to utilize this feature. This configuration option
	  encompasses various features that the driver may use.
	  If the driver wishes to employ the UB feature, this
	  configuration must be enabled.
	  Select 'M' to build these features as a loadable kernel module.

config UB_UMMU_SVA_SEPARATED_PAGES
	bool "Support for UMMU SVA to establish separated page tables"
	help
	  The hardware does not support IOPF capability, using SVA
	  armed page tables can lead to page faults due to periodic
	  memory tasks. By separating the process page table from the
	  MMU page table, the goal of SVA programming is achieved.
	  using SVA in this scenario say 'Y' here.
endif
```

## drivers/misc/zcopy/Kconfig
```kconfig
# SPDX-License-Identifier: GPL-2.0-only
config PAGEATTACH
	tristate "PAGEATTACH: A zero-copy data transfer mechanism"
	depends on MMU && ARM64
	help
		This option enables the PAGEATTACH mechanism, a zero-copy data transfer
		solution optimized for like High Performance Computing workloads. It
		allows direct sharing of physical memory pages between distinct processes
		by mapping source pages to a target address space, eliminating redundant
		data copying and improving large data transfer efficiency.

		Key features:
		- Supports zero-copy communication between intra-node processes.
		- Handles both PTE-level pages and PMD-level huge pages.
		- Preserves the read/write permissions of the source page in the target address space.

		This mechanism is intended for HPC applications requiring high-speed inter-process
		data sharing. If your use case does not meet the above constraints or you are unsure,
		disable this option by saying N.
```

## drivers/nds/Kconfig
```kconfig
# SPDX-License-Identifier: GPL-2.0-only

menuconfig NDS
	tristate "NDS NVMe peer-to-peer I/O"
	depends on BLOCK && BLK_DEV_NVME
	help
	  NDS provides a character device and UAPI for NVMe peer-to-peer
	  I/O against registered device memory (e.g. NPU HBM).

	  If unsure, say N.

if NDS

config NDS_P2P_DEV
	tristate "NDS p2p_dev driver"
	default m
	help
	  Core NDS driver (/dev/nds_p2p*). Provides ioctl submit/complete
	  paths for peer-to-peer DMA I/O.

	  To compile this driver as a module, choose M here: the
	  module will be called p2p_dev.

endif # NDS
```

## drivers/net/ethernet/dinghai/Kconfig
```kconfig
config NET_VENDOR_DINGHAI
    tristate "Dinghai Devices"
    depends on PCI && (X86 || ARM64)
    help
      This option enables support for Ethernet devices from
      Dinghai (ZTE) corporation.

      Dinghai Ethernet adapters provide high-performance networking
      capabilities including hardware offloading, RDMA, and SR-IOV.

      To compile this driver as a module, choose M here. The module
      will be called dinghai.ko.

      If unsure, say N.

if NET_VENDOR_DINGHAI

config DINGHAI_DH_CMD
	tristate "Dinghai Command Interface Support"
	help
	  Say Y or M here to enable the command interface for Dinghai
	  Ethernet devices.

	  This module provides low-level command communication channel
	  between the host and Dinghai hardware.

	  To compile this driver as a module, choose M here. The module
	  will be called dinghai_cmd.ko.

	  If unsure, say N.

config DINGHAI_NP
	tristate "Dinghai Network Processor Support"
	depends on DINGHAI_DH_CMD
	help
	  Say Y or M here to enable Network Processor (NP) support for
	  Dinghai Ethernet devices.

	  This module is required for network packet processing offload
	  features. It depends on the DINGHAI_DH_CMD module.

	  To compile this driver as a module, choose M here. The module
	  will be called dinghai_np.ko.

	  If unsure, say N.

config DINGHAI_PTP
	tristate "Dinghai Precision Time Protocol Support"
	depends on DINGHAI_DH_CMD && PTP_1588_CLOCK
	help
	  Say Y or M here to enable Precision Time Protocol (PTP)
	  support for Dinghai Ethernet devices.

	  This module provides hardware timestamping and clock
	  synchronization features. It requires DINGHAI_DH_CMD and
	  PTP_1588_CLOCK to be enabled.

	  To compile this driver as a module, choose M here. The module
	  will be called dinghai_ptp.ko.

	  If unsure, say N.

config DINGHAI_TSN_M
	tristate "Dinghai Time-Sensitive Networking Module"
	help
	  Say Y or M here to enable Time-Sensitive Networking (TSN)
	  runtime module support for Dinghai Ethernet devices.

	  This module provides TSN features including 802.1Qbv, 802.1Qbu,
	  and frame preemption capabilities.

	  To compile this driver as a module, choose M here. The module
	  will be called dinghai_tsn.ko.

	  If unsure, say N.

config DINGHAI_SEC
	tristate "Dinghai Security Module Support"
	help
	  Say Y or M here to enable Security (SEC) module support for
	  Dinghai Ethernet devices.

	  This module provides hardware security features including
	  encryption, decryption, and secure key management.

	  To compile this driver as a module, choose M here. The module
	  will be called dinghai_sec.ko.

	  This feature is experimental; say N if unsure.

config DINGHAI_AUXILIARY
	tristate "Dinghai Auxiliary Bus Support"
	help
	  Say Y or M here to enable auxiliary bus support for Dinghai
	  Ethernet devices.

	  This module provides the auxiliary bus infrastructure used
	  for managing sub-devices.

	  To compile this driver as a module, choose M here. The module
	  will be called dinghai_auxiliary.ko.

	  If unsure, say N.

config DINGHAI_PF
	tristate "Dinghai Primary Function Driver"
	depends on DINGHAI_DH_CMD
	depends on DINGHAI_AUXILIARY
	depends on DINGHAI_NP
	depends on DINGHAI_PTP
	depends on DINGHAI_TSN_M
	help
	  Say Y or M here to enable the Primary Function (PF) driver
	  for Dinghai Ethernet devices.

	  This is the main driver that manages the physical function
	  of Dinghai adapters. It supports:
	    - SR-IOV for virtual functions
	    - RDMA over Converged Ethernet (RoCE)
	    - Hardware offloading features

	  This driver requires the following modules to be enabled:
	    - DINGHAI_DH_CMD (command interface)
	    - DINGHAI_AUXILIARY (auxiliary bus)
	    - DINGHAI_NP (network processor)
	    - DINGHAI_PTP (PTP support, requires PTP_1588_CLOCK)
	    - DINGHAI_TSN_M (TSN runtime support)

	  To compile this driver as a module, choose M here. The module
	  will be called dinghai_pf.ko.

	  If unsure, say N.

endif # NET_VENDOR_DINGHAI
```

## drivers/net/ethernet/huawei/hinic5/Kconfig
```kconfig
# SPDX-License-Identifier: GPL-2.0-only
#
# Huawei driver configuration
#

config HINIC5
	tristate "Huawei Intelligent Network Interface Card 5th"
	depends on PCI_MSI && NUMA && PCI_IOV && DCB && (X86 || ARM64)
	help
	  This driver supports HiNIC PCIE Ethernet cards.
	  To compile this driver as part of the kernel, choose Y here.
	  If unsure, choose N.
	  The default is N.
```

## drivers/soc/hisilicon/Kconfig
```kconfig
# SPDX-License-Identifier: GPL-2.0-only

menu "Hisilicon SoC drivers"
	depends on ARCH_HISI || COMPILE_TEST

config HISI_HBMDEV
	bool "add extra support for hbm memory device"
	depends on ACPI_HOTPLUG_MEMORY && ARCH_HISI
	select ACPI_CONTAINER
	help
	  This driver add two extra supports for memory devices. The driver
	  provides methods for userpace to control the power of memory devices
	  in a container. Besides, it provides extra locality information
	  between cpus and memory devices for userspace, which can take
	  advantage of this functionality to select the closet memory device
	  to a certain cpu.

	  To compile this driver as a module, choose M here:
	  the module will be called hisi_hbmdev.

config HISI_HBMCACHE
	tristate "HBM cache memory device"
	depends on ACPI
	help
	  This driver provids methods to control the power of hbm cache device
	  in hisi soc. Use hbm as a cache can take advantage of hbm's high
	  bandwidth in normal memory access.

	  To compile the driver as a module, choose M here:
	  the module will be called hisi_hbmcache.

config KUNPENG_HCCS
	tristate "HCCS driver on Kunpeng SoC"
	depends on ACPI
	depends on PCC
	depends on ARM64 || COMPILE_TEST
	help
	  The Huawei Cache Coherence System (HCCS) is a multi-chip
	  interconnection bus protocol.
	  The performance of application may be affected if some HCCS
	  ports are not in full lane status, have a large number of CRC
	  errors and so on. This may support for reducing system power
	  consumption if there are HCCS ports supported low power feature
	  on platform.

	  Say M here if you want to include support for querying the
	  health status and port information of HCCS, or reducing system
	  power consumption on Kunpeng SoC.

config HISI_SOC_CACHE
	bool "HiSilicon Cache driver for Kunpeng SoC"
	depends on ARCH_HISI
	help
	  This driver provides the basic utilities for drivers of
	  different part of Kunpeng SoC cache, including L3 cache and
	  Hydra Home Agent etc.

	  If either HiSilicon L3 cache driver or HiSilicon Hydra Home
	  Agent driver is needed, say yes.

config HISI_SOC_L3C
	tristate "HiSilicon L3 Cache device driver"
	depends on ARM64 && ACPI || COMPILE_TEST
	depends on HISI_SOC_CACHE
	help
	  This driver provides the functions to lock L3 cache entries from
	  being evicted for better performance.

	  This driver can be built as a module. If so, the module will be
	  called hisi_soc_l3c.

config HISI_SOC_HHA
	tristate "HiSilicon Hydra Home Agent (HHA) device driver"
	depends on ARM64 && ACPI || COMPILE_TEST
	depends on HISI_SOC_CACHE
	help
	  The Hydra Home Agent (HHA) is responsible of cache coherency
	  on SoC. This drivers provides cache maintenance functions of HHA.

	  This driver can be built as a module. If so, the module will be
	  called hisi_soc_hha.

endmenu
```

## drivers/tee/optee/Kconfig
```kconfig
# SPDX-License-Identifier: GPL-2.0-only
# OP-TEE Trusted Execution Environment Configuration
config OPTEE
	tristate "OP-TEE"
	depends on HAVE_ARM_SMCCC
	depends on MMU
	help
	  This implements the OP-TEE Trusted Execution Environment (TEE)
	  driver.

config OPTEE_SHM_NUM_PRIV_PAGES
	int "Private Shared Memory Pages"
	default 1
	depends on OPTEE
	help
	  This sets the number of private shared memory pages to be
	  used by OP-TEE TEE driver.

config TEE_SGI_INTERRUPT
    bool "TEE to REE SGI interrupt support"
    depends on OPTEE && SMP && ARM_GIC_V3 && ARCH_PHYTIUM
    default n
    help
      This option enables Secure World (TEE) to Normal World (REE) interrupt
      notification using SGI (Software Generated Interrupt) #8.
      When enabled, the TEE can trigger an SGI interrupt to notify the REE
      of events or requests, facilitating secure/normal world communication.
      Say N if you are unsure or do not require TEE-REE interrupt communication.
```

## drivers/ub/Kconfig
```kconfig
# SPDX-License-Identifier: GPL-2.0+
#
# UnifiedBus configuration
#

menuconfig UB
       bool "UB (UnifiedBus) support"
       depends on ARM64
       default n
       help
         Support for UB.
         If you have a hardware that support UB protocol,
         Say y here. By Default this option is closed.

if UB
source "drivers/ub/ubus/Kconfig"
source "drivers/ub/ubfi/Kconfig"
source "drivers/ub/ubase/Kconfig"
source "drivers/ub/cdma/Kconfig"
source "drivers/ub/urma/hw/udma/Kconfig"
source "drivers/ub/obmm/Kconfig"
source "drivers/ub/sentry/Kconfig"
source "drivers/ub/ubdevshm/Kconfig"
source "drivers/ub/ubmempfd/Kconfig"
source "drivers/ub/ubaseproxy/Kconfig"

config UB_URMA
	tristate "Unified Bus (UB) urma support"
	default m
	help
	  Unified remote memory access(URMA) support. This
	  is the kernel side of the userspace urma support, which allows
	  userspace processes to send and receive urma cmd. You will also
	  need liburma from umdk

endif # UB
```

## drivers/ub/obmm/Kconfig
```kconfig
# SPDX-License-Identifier: GPL-2.0-only
config OBMM
	default n
	tristate "OBMM(ownership based memory management) Support"
	depends on UB_UMMU_CORE && UB_UBUS && HISI_SOC_CACHE && ARCH_HAS_COPY_MC
	select NUMA_REMOTE
	select PFN_RANGE_ALLOC
	select RECLAIM_NOTIFY
	help
	  OBMM (Ownership Based Memory Management) provides a framework for
	  managing shared memory regions across multiple systems.
	  It supports both memory import (accessing remote memory) and export
	  (making local memory visible across systems) operations with proper
		NUMA integration and provides capability of cross-supernode cache
		consistency maintenance.
	  If unsure, say N.
```

## drivers/ub/sentry/Kconfig
```kconfig
# SPDX-License-Identifier: GPL-2.0-only

config UB_SENTRY
    tristate "sentry message report"
    depends on UB && ACPI_POWER_NOTIFIER_CHAIN && ACPI_APEI_GHES
    default m
    help
      Listens to kernel event(eg. oom) and send sentry msg to userspace
      Provides device for userspace to read kernel message and reply ack
      Provides kernel api to send message to userspace and wait for result

config UB_SENTRY_REMOTE
    tristate "sentry remote event reporter module"
    depends on UB_SENTRY && UB_URMA
    default m
    help
      report panic/reboot event msg
```

## drivers/ub/ubaseproxy/Kconfig
```kconfig
# SPDX-License-Identifier: GPL-2.0+
menuconfig UB_UBASEPROXY
	default n
	tristate "ubaseproxy driver"
	depends on UB_UBASE
	help
	   This option enables support for ubaseproxy drivers. ubaseproxy
           is a device driver proxy module responsible for functions such
           as TA anti-attack protection; it can subsequently support
           features like live migration, as well as anti-attack and live
           migration capabilities for cdma and other device drivers.
```
